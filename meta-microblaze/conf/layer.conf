## meta-xilinx-multimedia/conf/layer.conf
```bitbake
# We have a conf and classes directory, add to BBPATH
BBPATH .= ":${LAYERDIR}"

# We have a packages directory, add to BBFILES
BSP_XILINX_DERIVED ??= ""
BBFILES += "${@bb.utils.contains_any('MACHINE', '${BSP_XILINX_DERIVED}', '${LAYERDIR}/recipes-*/*/*.bb', '', d)}"
BBFILES += "${@bb.utils.contains_any('MACHINE', '${BSP_XILINX_DERIVED}', '${LAYERDIR}/recipes-*/*/*.bbappend', '', d)}"

BBFILE_COLLECTIONS += "xilinx-multimedia"
BBFILE_PATTERN_xilinx-multimedia = "^${LAYERDIR}/"
BBFILE_PRIORITY_xilinx-multimedia = "5"

# set layer path for this layer only
LAYER_PATH_xilinx-multimedia = "${LAYERDIR}"

LAYERDEPENDS_xilinx-multimedia = "core"
LAYERRECOMMENDS_xilinx-multimedia = "openembedded-layer"

LAYERSERIES_COMPAT_xilinx-multimedia = "scarthgap walnascar"

# Define dynamic layers
BBFILES_DYNAMIC += " \
jupyter-layer:${LAYERDIR}/dynamic-layers/meta-jupyter/recipes-*/*/*.bb \
jupyter-layer:${LAYERDIR}/dynamic-layers/meta-jupyter/recipes-*/*/*.bbappend \
"

BBMASK += "${LAYERDIR}/recipes-multimedia/"
```
